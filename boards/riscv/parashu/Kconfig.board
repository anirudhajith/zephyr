## boards/riscv/parashu/Kconfig.board
```kconfig
# SPDX-License-Identifier: Apache-2.0

config BOARD_PARASHU
	bool "PARASHU RISC-V cores"
	depends on SOC_RISCV_SHAKTI_ECLASS
```

## boards/riscv/parashu/Kconfig.defconfig
```kconfig
# SPDX-License-Identifier: Apache-2.0

if BOARD_PARASHU

config BOARD
	default "parashu"

config HAS_FLASH_LOAD_OFFSET
	default n

config SYS_CLOCK_TICKS_PER_SEC
	default 128

endif
```

## boards/riscv/parashu/parashu_defconfig
```kconfig
# SPDX-License-Identifier: Apache-2.0


CONFIG_SOC_SERIES_RISCV_SHAKTI=y
CONFIG_SOC_RISCV_SHAKTI_ECLASS=y
CONFIG_BOARD_PARASHU=y
CONFIG_CONSOLE=y
CONFIG_PRINTK=y
CONFIG_SERIAL=y
CONFIG_UART_CONSOLE=y
CONFIG_UART_SHAKTI=y
CONFIG_UART_SHAKTI_PORT_0=y
CONFIG_UART_INTERRUPT_DRIVEN=n
CONFIG_RISCV_MACHINE_TIMER=y
CONFIG_PLIC=y
```

## boards/riscv/pinaka/Kconfig.board
```kconfig
# SPDX-License-Identifier: Apache-2.0

config BOARD_PINAKA
	bool "PINAKA RISC-V cores"
	depends on SOC_RISCV_SHAKTI_ECLASS
```

## boards/riscv/pinaka/Kconfig.defconfig
```kconfig
# SPDX-License-Identifier: Apache-2.0

if BOARD_PINAKA

config BOARD
	default "pinaka"

config HAS_FLASH_LOAD_OFFSET
	default n

config SYS_CLOCK_TICKS_PER_SEC
	default 128

endif
```

## drivers/serial/Kconfig.shakti
```kconfig
# Shakti  UART configuration option

# SPDX-License-Identifier: Apache-2.0

menuconfig UART_SHAKTI
	bool "Shakti  serial driver"
	depends on SOC_RISCV_SHAKTI_CCLASS
	select SERIAL_HAS_DRIVER
	select SERIAL_SUPPORT_INTERRUPT
	help
	  This option enables the Shakti  serial driver.

# ---------- Port 0 ----------

menuconfig UART_SHAKTI_PORT_0
	bool "Enable SHAKTI Port 0"
	depends on UART_SHAKTI
	help
	  This tells the driver to configure the UART port at boot, depending on
	  the additional configure options below.

config UART_SHAKTI_PORT_0_IRQ_PRIORITY
	int "Port 0 Interrupt Priority"
	default 1
	depends on UART_SHAKTI_PORT_0
	help
	  Port 0 Interrupt Priority

config UART_SHAKTI_PORT_0_RXCNT_IRQ
	int "Port 0 RX Interrupt Threshold Count"
	default 0
	depends on UART_SHAKTI_PORT_0
	help
	  Port 0 RX Threshold at which the RX FIFO interrupt triggers.

config UART_SHAKTI_PORT_0_TXCNT_IRQ
	int "Port 0 TX Interrupt Threshold Count"
	default 1
	depends on UART_SHAKTI_PORT_0
	help
	  Port 0 TX Threshold at which the TX FIFO interrupt triggers.

# ---------- Port 1 ----------

menuconfig UART_SHAKTI_PORT_1
	bool "Enable SHAKTI Port 1"
	depends on UART_SHAKTI
	help
	  This tells the driver to configure the UART port at boot, depending on
	  the additional configure options below.

config UART_SHAKTI_PORT_1_IRQ_PRIORITY
	int "Port 1 Interrupt Priority"
	default 1
	depends on UART_SHAKTI_PORT_1
	help
	  Port 1 Interrupt Priority

config UART_SHAKTI_PORT_1_RXCNT_IRQ
	int "Port 0 RX Interrupt Threshold Count"
	default 0
	depends on UART_SHAKTI_PORT_1
	help
	  Port 1 RX Threshold at which the RX FIFO interrupt triggers.

config UART_SHAKTI_PORT_1_TXCNT_IRQ
	int "Port 1 TX Interrupt Threshold Count"
	default 0
	depends on UART_SHAKTI_PORT_1
	help
	  Port 1 TX Threshold at which the TX FIFO interrupt triggers.
```

## dts/bindings/serial/shakti,uart0.yaml
```yaml
# SPDX-License-Identifier: Apache-2.0

description: Shakti UART

compatible: "shakti,uart0"

include: uart-controller.yaml

properties:
    reg:
      required: true

    interrupts:
      required: true
```

## soc/riscv/riscv-privilege/eclass/Kconfig.defconfig.series
```kconfig
# SPDX-License-Identifier: Apache-2.0

if SOC_SERIES_RISCV_SHAKTI

config SOC_SERIES
	default "eclass"

config SYS_CLOCK_HW_CYCLES_PER_SEC
	default 50000000

config RISCV_SOC_INTERRUPT_INIT
	default y

config RISCV_HAS_CPU_IDLE
	default y

config RISCV_HAS_PLIC
	default y

config NUM_IRQS
	default 64

endif # SOC_SERIES_RISCV_SHAKTI
```

## soc/riscv/riscv-privilege/eclass/Kconfig.series
```kconfig
# RISCV_SHAKTI SOC implementation

# SPDX-License-Identifier: Apache-2.0

config SOC_SERIES_RISCV_SHAKTI
	bool "Shakti SOC implementation"
	select RISCV
	select SOC_FAMILY_RISCV_PRIVILEGE
	help
	  Enable support for Shakti SOC
```

## soc/riscv/riscv-privilege/eclass/Kconfig.soc
```kconfig
# RISCV_SHAKTI SOC configuration options
# SPDX-License-Identifier: Apache-2.0

choice
	prompt "Shakti Eclass SOC implementation"
	depends on SOC_SERIES_RISCV_SHAKTI

config SOC_RISCV_SHAKTI_ECLASS
	bool "Shakti Eclass SoC implementation"
	select ATOMIC_OPERATIONS_C

endchoice
```
